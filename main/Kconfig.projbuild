## main/Kconfig.projbuild
```kconfig
menu "Bicycle LED Board"

    choice BICYCLE_BOARD_REVISION
        prompt "Bicycle Board Revision"
        default BICYCLE_BOARD_REVISION_V1
        help
            Select the revision of the bicycle board you are using.

        config BICYCLE_BOARD_REVISION_V1
            bool "Bicycle Board V1"

    endchoice

    config RESET_VIA_CONSOLE
        bool "Expose nvs reset via UART (key \"s\")"
        default false
        help
            This option allows you to reset the NVS configuration via the console.
            This is useful for debugging and development purposes.

    menu "Defaults"

        config BICYCLE_DEFAULT_LED_LENGTH
            int "Default LED strip length"
            default 288 if BICYCLE_BOARD_REVISION_V1
            help
                The default length of the LED strip, used for the config.
                The default is 288 LEDs as in 2x 144 LEDs strip.

    endmenu # "Defaults"

    menu "Pin definitions"

        config BICYCLE_PIN_LCD_LED
            int "TFT backlight pin"
            default 32 if BICYCLE_BOARD_REVISION_V1

        config BICYCLE_PIN_LED_DATA
            int "WS2812 data pin"
            default 34 if BICYCLE_BOARD_REVISION_V1

        config BICYCLE_PIN_SPEEDSENSOR
            int "Speed sensor pin"
            default 36 if BICYCLE_BOARD_REVISION_V1

        config BICYCLE_PIN_I2C_SDA
            int "I2C SDA pin"
            default 16 if BICYCLE_BOARD_REVISION_V1

        config BICYCLE_PIN_I2C_SCL
            int "I2C SCL pin"
            default 17 if BICYCLE_BOARD_REVISION_V1

        menu "Button pins"

            config BICYCLE_PIN_BUTTON_IN_1
                int "Button IN 1"
                default 21 if BICYCLE_BOARD_REVISION_V1

            config BICYCLE_PIN_BUTTON_IN_2
                int "Button IN 2"
                default 18 if BICYCLE_BOARD_REVISION_V1

            config BICYCLE_PIN_BUTTON_IN_3
                int "Button IN 3"
                default 22 if BICYCLE_BOARD_REVISION_V1

            config BICYCLE_PIN_BUTTON_IN_4
                int "Button IN 4"
                default 23 if BICYCLE_BOARD_REVISION_V1

            config BICYCLE_PIN_BUTTON_OUT_1
                int "Button OUT 1"
                default 19 if BICYCLE_BOARD_REVISION_V1

            config BICYCLE_PIN_BUTTON_OUT_2
                int "Button OUT 2"
                default 5 if BICYCLE_BOARD_REVISION_V1

        endmenu # "Button pins"

    endmenu # "Pin definitions"

    menu "Hardware Config"

        config BICYCLE_GPIO_EXPANDER_ADDRESS
            hex "GPIO expander I2C address"
            default 0x70 if BICYCLE_BOARD_REVISION_V1
            help
                The I2C address of the GPIO expander. The default is 0x0C (00001100b).

        config BICYCLE_GPIO_EXPANDER_PWM_FREQ_HZ
            int "GPIO expander PWM frequency"
            default 1500
            range 0 1600
            help
                The frequency of the PWM outputs on the GPIO expander.

        choice BICYCLE_ADC_ADDRESS
            prompt "ADC I2C address"
            default BICYCLE_ADC_ADDRESS_GND
            help
                Select which jumper is set for the ADDR pin of the ADS1115.

            config BICYCLE_ADC_ADDRESS_GND
                bool
                prompt "ADC I2C address GND"
            config BICYCLE_ADC_ADDRESS_VCC
                bool
                prompt "ADC I2C address VCC"
            config BICYCLE_ADC_ADDRESS_SDA
                bool
                prompt "ADC I2C address SDA"
            config BICYCLE_ADC_ADDRESS_SCL
                bool
                prompt "ADC I2C address SCL"

        endchoice

    endmenu # "Hardware Config"

    menu "Debug"

        config BICYCLE_DEBUG_I2C
            bool "Enable I2C debug"
            default false
            help
                Enable I2C debug. Also tries to scan for i2c on startup.

    endmenu # "Debug"

endmenu
```
